#define KEYS_L LT0 LT1 LT2 LT3 LT4 LM0 LM1 LM2 LM3 LM4 LB0 LB1 LB2 LB3 LB4
#define KEYS_R RT0 RT1 RT2 RT3 RT4 RM0 RM1 RM2 RM3 RM4 RB0 RB1 RB2 RB3 RB4
#define THUMBS LH1 LH0 RH0 RH1

#define EN 0
#define RU 1
#define NAS 2
#define NAV 3
#define MOUSE 4
#define FK 5
#define G_A 6
#define G_B 7

#define SET_EN LA(LS(N1))
#define SET_RU LA(LS(N2))

#define OPEN_CHAT ENTER
#define OPEN_GLOBAL_CHAT LS(OPEN_CHAT)

#define BUFFER LG(V)
#define EMOJI LG(DOT)

#ifndef ZMK_BASE_LAYER
    #define ZMK_BASE_LAYER(name, LT, RT, LM, RM, LB, RB, LH, RH) \
        ZMK_LAYER(name, LT RT LM RM LB RB LH RH)
#endif

#define QUICK_TAP_MS 175

// REMARK: Trigger tap-action on all interrupts
#define MT_CORE                                                                \
    flavor = "tap-preferred";                                                  \
    tapping-term-ms = <220>;                                                   \
    quick-tap-ms = <220>;                                                      \
    hold-trigger-key-positions = <0>;

&sk {
    release-after-ms = <900>;
    quick-release;
};

// REMARK: Allow sticky mods to chord across sticky layers
&sl {
    ignore-modifiers;
};

&lt {
    flavor = "balanced";
    tapping-term-ms = <200>;
    quick-tap-ms = <QUICK_TAP_MS>;
};

&mt {
    MT_CORE
};
