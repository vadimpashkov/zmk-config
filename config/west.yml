## config/west.yml
```yaml
manifest:
  defaults:
    revision: v0.3
  remotes:
    - name: zmkfirmware
      url-base: https://github.com/zmkfirmware
    - name: urob
      url-base: https://github.com/urob
  projects:
    - name: zmk
      remote: zmkfirmware
      import: app/west.yml
    - name: zmk-helpers
      remote: urob
      revision: main
    - name: zmk-unicode
      remote: urob
      revision: v0.3 # set to same as ZMK version above
    - name: zmk-leader-key
      remote: urob
      revision: v0.3 # set to same as ZMK version above
  self:
    path: config
```
