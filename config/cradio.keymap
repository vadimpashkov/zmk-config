#include <behaviors.dtsi>
#include <behaviors/unicode.dtsi>
#include <dt-bindings/zmk/keys.h>
#include <dt-bindings/zmk/bt.h>
#include <zmk-helpers/helper.h>
#include <zmk-helpers/key-labels/34.h>

#include "keys_ru.h"

#include "cradio/defs.dtsi"
#include "cradio/hrm.dtsi"
#include "cradio/layer-bindings.dtsi"
#include "cradio/tap-dances.dtsi"
#include "cradio/hold-tap.dtsi"
#include "cradio/macros.dtsi"
#include "cradio/combos.dtsi"
#include "cradio/leader.dtsi"
#include "cradio/mouse.dtsi"
#include "cradio/auto-layers.dtsi"

ZMK_BASE_LAYER(En,
//╭─────────────┬─────────────┬─────────────┬─────────────┬─────────────╮ ╭─────────────┬─────────────┬─────────────┬─────────────┬─────────────╮
    &kp Q         &kp W         &kp F         &kp P         &kp B       ,   &kp J         &kp L         &kp U         &kp Y         &sqt_dqt    ,
//├─────────────┼─────────────┼─────────────┼─────────────┼─────────────┤ ├─────────────┼─────────────┼─────────────┼─────────────┼─────────────┤
                          _HML_KEYS_                        &kp G       ,   &kp M                               _HMR_KEYS_                      ,
//├─────────────┼─────────────┼─────────────┼─────────────┼─────────────┤ ├─────────────┼─────────────┼─────────────┼─────────────┼─────────────┤
    &kp Z         &kp X         &kp C         &kp D         &kp V       ,   &kp K         &kp H         &comma_semi   &dot_colon    &qmark_excl ,
//╰─────────────┴─────────────┴─────────────┼─────────────┼─────────────┤ ├─────────────┼─────────────┼─────────────┴─────────────┴─────────────╯
                                              &mo SYSTEM    &kp SPACE   ,   &kp BSPC      &kp ENTER
//                                          ╰─────────────┴─────────────╯ ╰─────────────┴─────────────╯
)

ZMK_BASE_LAYER(Ru,
//╭─────────────┬─────────────┬─────────────┬─────────────┬─────────────╮ ╭─────────────┬─────────────┬─────────────┬─────────────┬─────────────╮
    &kp RU_BI     &kp RU_K      &kp RU_L      &kp RU_B      &ru_ch_ts   ,   &ru_sh_shch   &ru_u_yu      &kp RU_YA     &kp RU_E      &kp RU_DQT  ,
//├─────────────┼─────────────┼─────────────┼─────────────┼─────────────┤ ├─────────────┼─────────────┼─────────────┼─────────────┼─────────────┤
                        _HML_RU_KEYS_                       &kp RU_D    ,   &ru_i_y                           _HMR_RU_KEYS_                     ,
//├─────────────┼─────────────┼─────────────┼─────────────┼─────────────┤ ├─────────────┼─────────────┼─────────────┼─────────────┼─────────────┤
    &ru_kh_zh     &kp RU_P      &kp RU_R      &kp RU_M      &kp RU_G    ,   &kp RU_F     &ru_soft_hard  &ru_ca_si     &ru_dt_cn     &ru_qk_el   ,
//╰─────────────┴─────────────┴─────────────┼─────────────┼─────────────┤ ├─────────────┼─────────────┼─────────────┴─────────────┴─────────────╯
                                              &mo SYSTEM    &kp SPACE   ,   &kp BSPC      &kp ENTER
//                                          ╰─────────────┴─────────────╯ ╰─────────────┴─────────────╯
)

ZMK_BASE_LAYER(Nas,
// ╭─────────────┬─────────────┬─────────────┬─────────────┬─────────────╮ ╭─────────────┬─────────────┬─────────────┬─────────────┬─────────────╮
     &kp PLUS      &kp N1        &kp N2        &kp N3        &fslh_bslh  ,   &kp GRAVE     &kp HASH      &kp AT        &kp PRCNT     &sqt_dqt    ,
// ├─────────────┼─────────────┼─────────────┼─────────────┼─────────────┤ ├─────────────┼─────────────┼─────────────┼─────────────┼─────────────┤
                         _HML_NAS_KEYS_                      &kp EQUAL   ,   &amps_pipe                        _HMR_NAS_KEYS_                    ,
// ├─────────────┼─────────────┼─────────────┼─────────────┼─────────────┤ ├─────────────┼─────────────┼─────────────┼─────────────┼─────────────┤
     &kp STAR      &kp N7        &kp N8        &kp N9        &kp MINUS   ,   &dllr_tilde   &under_caret  &comma_semi   &dot_colon    &qmark_excl ,
// ╰─────────────┴─────────────┴─────────────┼─────────────┼─────────────┤ ├─────────────┼─────────────┼─────────────┴─────────────┴─────────────╯
                                               &mo SYSTEM    &kp SPACE   ,   &kp BSPC      &kp ENTER
//                                           ╰─────────────┴─────────────╯ ╰─────────────┴─────────────╯
)

ZMK_BASE_LAYER(Nav,
//╭─────────────┬─────────────┬─────────────┬─────────────┬─────────────╮ ╭─────────────┬─────────────┬─────────────┬─────────────┬─────────────╮
   &buffer_emoji  &kp HOME      &kp UP        &kp END       &kp D_REDO  ,   XXX           XXX           XXX           XXX           &sqt_dqt    ,
//├─────────────┼─────────────┼─────────────┼─────────────┼─────────────┤ ├─────────────┼─────────────┼─────────────┼─────────────┼─────────────┤
    &kp LS(TAB)   &kp LEFT      &kp DOWN      &kp RIGHT     &kp TAB     ,   XXX           &kp RSHFT     &kp RCTRL     &kp LALT      &kp LGUI    ,
//├─────────────┼─────────────┼─────────────┼─────────────┼─────────────┤ ├─────────────┼─────────────┼─────────────┼─────────────┼─────────────┤
                        _HML_NAV_KEYS_                      &kp D_UNDO  ,   XXX           XXX           &comma_semi   &dot_colon    &qmark_excl ,
//╰─────────────┴─────────────┴─────────────┼─────────────┼─────────────┤ ├─────────────┼─────────────┼─────────────┴─────────────┴─────────────╯
                                              &mo SYSTEM    &kp SPACE   ,   &kp BSPC      &kp ENTER
//                                          ╰─────────────┴─────────────╯ ╰─────────────┴─────────────╯
)

ZMK_BASE_LAYER(Mouse,
//╭─────────────┬─────────────┬─────────────┬─────────────┬─────────────╮ ╭─────────────┬─────────────┬─────────────┬─────────────┬─────────────╮
    &kp PG_DN     U_WH_D        U_MS_U        U_WH_U        &kp PG_UP   ,   ___           ___           ___           ___           &sqt_dqt    ,
//├─────────────┼─────────────┼─────────────┼─────────────┼─────────────┤ ├─────────────┼─────────────┼─────────────┼─────────────┼─────────────┤
    U_WH_L        U_MS_L        U_MS_D        U_MS_R        U_WH_R      ,   ___           &kp RSHFT     &kp RCTRL     &kp LALT      &kp LGUI    ,
//├─────────────┼─────────────┼─────────────┼─────────────┼─────────────┤ ├─────────────┼─────────────┼─────────────┼─────────────┼─────────────┤
    ___           &mkp RCLK     &mkp MCLK     &mkp LCLK     ___         ,   ___           ___           &comma_semi   &dot_colon    &qmark_excl ,
//╰─────────────┴─────────────┴─────────────┼─────────────┼─────────────┤ ├─────────────┼─────────────┼─────────────┴─────────────┴─────────────╯
                                              &mo SYSTEM    &kp SPACE   ,   &kp BSPC      &kp ENTER
//                                          ╰─────────────┴─────────────╯ ╰─────────────┴─────────────╯
)

ZMK_BASE_LAYER(Fk,
//╭─────────────┬─────────────┬─────────────┬─────────────┬─────────────╮ ╭─────────────┬─────────────┬─────────────┬─────────────┬─────────────╮
    &kp F11       &kp F1        &kp F2        &kp F3        &kp WINSCST ,   &kp PSCRN     &kp F15       &kp F14       &kp F13       &kp F23     ,
//├─────────────┼─────────────┼─────────────┼─────────────┼─────────────┤ ├─────────────┼─────────────┼─────────────┼─────────────┼─────────────┤
    &kp F10       &kp F4        &kp F5        &kp F6        XXX         ,   XXX           &kp F18       &kp F17       &kp F16       &kp F22     ,
//├─────────────┼─────────────┼─────────────┼─────────────┼─────────────┤ ├─────────────┼─────────────┼─────────────┼─────────────┼─────────────┤
    &kp F12       &kp F7        &kp F8        &kp F9        XXX         ,   XXX           &kp F21       &kp F20       &kp F19       &kp F24     ,
//╰─────────────┴─────────────┴─────────────┼─────────────┼─────────────┤ ├─────────────┼─────────────┼─────────────┴─────────────┴─────────────╯
                                              XXX           XXX         ,   XXX           XXX
//                                          ╰─────────────┴─────────────╯ ╰─────────────┴─────────────╯
)

ZMK_BASE_LAYER(System,
//╭─────────────┬─────────────┬─────────────┬──────────────┬─────────────╮ ╭─────────────┬─────────────┬─────────────┬─────────────┬─────────────╮
    &kp ESC       XXX          &to_nas_layer  XXX            XXX         ,   XXX           XXX           XXX           XXX           XXX         ,
//├─────────────┼─────────────┼─────────────┼──────────────┼─────────────┤ ├─────────────┼─────────────┼─────────────┼─────────────┼─────────────┤
    XXX          &to_ru_layer  &to_nav_layer  &to_en_layer   XXX         ,   XXX           XXX          &to_game_layer XXX           XXX         ,
//├─────────────┼─────────────┼─────────────┼──────────────┼─────────────┤ ├─────────────┼─────────────┼─────────────┼─────────────┼─────────────┤
    &sl FK        XXX         &to_mouse_layer XXX            XXX         ,   XXX           XXX           XXX           XXX           XXX         ,
//╰─────────────┴─────────────┴─────────────┼──────────────┼─────────────┤ ├─────────────┼─────────────┼─────────────┴─────────────┴─────────────╯
                                              ___            &kp ENTER   ,   &kp DEL       XXX
//                                          ╰──────────────┴─────────────╯ ╰─────────────┴─────────────╯
)

ZMK_BASE_LAYER(Game_Alpha,
//╭─────────────┬─────────────┬─────────────┬─────────────┬─────────────╮ ╭─────────────┬─────────────┬─────────────┬─────────────┬─────────────╮
    &kp TAB       &kp Q         &kp W         &kp E         &kp R       ,   XXX           &kp F1        &kp F2        &kp F3        &kp F11     ,
//├─────────────┼─────────────┼─────────────┼─────────────┼─────────────┤ ├─────────────┼─────────────┼─────────────┼─────────────┼─────────────┤
    &kp LSHFT     &kp A         &kp S         &kp D         &kp F       ,   XXX           &kp F4        &kp F5        &kp F6        &kp F10     ,
//├─────────────┼─────────────┼─────────────┼─────────────┼─────────────┤ ├─────────────┼─────────────┼─────────────┼─────────────┼─────────────┤
    &ctrl_alt     &kp Z         &kp X         &kp C         &kp V       ,   XXX           &kp F7        &kp F8        &kp F9        &kp F12     ,
//╰─────────────┴─────────────┴─────────────┼─────────────┼─────────────┤ ├─────────────┼─────────────┼─────────────┴─────────────┴─────────────╯
                                              &lt G_B H     &kp SPACE   ,   &open_chat    &open_global_chat
//                                          ╰─────────────┴─────────────╯ ╰─────────────┴─────────────╯
)

ZMK_BASE_LAYER(Game_Beta,
//╭─────────────┬─────────────┬─────────────┬─────────────┬─────────────╮ ╭─────────────┬─────────────┬─────────────┬─────────────┬─────────────╮
    &kp Y         &kp N1        &kp N2        &kp N3        &kp T       ,  &to_en_layer  &to_en_layer  &to_en_layer  &to_en_layer  &to_en_layer ,
//├─────────────┼─────────────┼─────────────┼─────────────┼─────────────┤ ├─────────────┼─────────────┼─────────────┼─────────────┼─────────────┤
    &kp N0        &kp N4        &kp N5        &kp N6        &kp G       ,  &to_en_layer  &to_en_layer  &to_en_layer  &to_en_layer  &to_en_layer ,
//├─────────────┼─────────────┼─────────────┼─────────────┼─────────────┤ ├─────────────┼─────────────┼─────────────┼─────────────┼─────────────┤
    &kp N         &kp N7        &kp N8        &kp N9        &kp B       ,  &to_en_layer  &to_en_layer  &to_en_layer  &to_en_layer  &to_en_layer ,
//╰─────────────┴─────────────┴─────────────┼─────────────┼─────────────┤ ├─────────────┼─────────────┼─────────────┴─────────────┴─────────────╯
                                              ___           &kp ENTER   ,  &to_en_layer  &to_en_layer
//                                          ╰─────────────┴─────────────╯ ╰─────────────┴─────────────╯
)
